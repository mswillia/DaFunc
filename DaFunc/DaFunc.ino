#include <SPI.h>
#include <Wire.h>
#include <Adafruit_GFX.h>
#include <Adafruit_SSD1306.h>
#include "avr/pgmspace.h"

#define OLED_RESET 4
Adafruit_SSD1306 display(OLED_RESET);

#define encoder0PinA  A2
#define encoder0PinB  A0
#define button  A1

#define PAGE_MAIN 0
#define PAGE_SIN 1
#define PAGE_TRI 2
#define PAGE_SQUARE 3
#define PAGE_COM 4

// table of 256 sine values / one sine period / stored in flash memory
PROGMEM  prog_uchar sine256[]  = {
  127,130,133,136,139,143,146,149,152,155,158,161,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240,
  242,243,244,245,247,248,249,249,250,251,252,252,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223,
  221,219,217,215,212,210,208,205,203,200,198,195,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78,
  76,73,70,67,64,62,59,56,54,51,49,46,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31,
  33,35,37,39,42,44,46,49,51,54,56,59,62,64,67,70,73,76,78,81,84,87,90,93,96,99,102,105,108,111,115,118,121,124
};

static const prog_uchar tri[] PROGMEM = {0, 0, 1, 2, 3, 4, 5, 6, 7, 8, 9, 10, 11,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 0, 0};

static const prog_uchar sine[] PROGMEM = {
0x00, 0x00, 0x00, 0x00, 0x00, 0x00, 0x00, 0x00, 0x00, 0x00, 0x00, 0x00, 0x00, 0x00, 0x00, 0x00,
0x00, 0x03, 0x60, 0x00, 0x00, 0x00, 0x00, 0x00, 0x00, 0x06, 0xC0, 0x00, 0x00, 0x00, 0x00, 0x00,
0x00, 0x04, 0x10, 0x00, 0x00, 0x00, 0x00, 0x00, 0x00, 0x08, 0x20, 0x00, 0x00, 0x00, 0x00, 0x00,
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0x00, 0x00, 0x00, 0x00, 0x00, 0x00, 0x00, 0x00, 0x00, 0x00, 0x00, 0x00, 0x00, 0x00, 0x00, 0x00
};

/*
int counter = 0;
volatile unsigned int freq = 1;

int tocallcount = 0;
void tocall() {
analogWrite(9, tri[(tocallcount++*freq)%512]);
}
*/


unsigned int encoder_sensitivity = 2;
volatile unsigned int page = PAGE_MAIN;
volatile unsigned int line = 0;
volatile unsigned int opage = -1;
volatile unsigned int oline = -1;
const byte waveforms[][2] PROGMEM = {
                                    {0x00,0x01},//sine
                                    {0x00,0x01}//triangle
                                   };
const char* lines[][5] = {{"Sine Wave","Triangle Wave","Square Wave","Compound Wave",""},
                         {"Frequency","Amplitude","Enabled","Back",""},
                         {"Frequency","Amplitude","Attack","Enabled","Back"},
                         {"Frequency","Amplitude","Duty","Enabled","Back"},
                         {"Sine Wave","Triangle Wave","Square Wave","Enabled","Back"}};
const int line_count[] = {4,4,5,5,5};

unsigned int mod(int a, int b) {
  return  (a+b) % b;
}

void handleEncoder() {
  if (digitalRead(encoder0PinA) == digitalRead(encoder0PinB)) {
    line = mod((line + 1),(line_count[page]*encoder_sensitivity));
  } else {
    line = mod((line - 1),(line_count[page]*encoder_sensitivity));
  }
}

void handleButton() {
  switch (page) {
    case PAGE_MAIN:
      page = (int)((float)line/(float)encoder_sensitivity)+1;
      line=0;
      break;
    case PAGE_SIN:
      if ((int)((float)line/(float)encoder_sensitivity) == line_count[page]-1) {
        page = 0;
        line=0;
      } else {
        //updateDisplay(lines[line+1]);
      }
      //line=0;
      break;
    case PAGE_TRI:
      if ((int)((float)line/(float)encoder_sensitivity) == line_count[page]-1) {
        page = 0;
        line=0;
      } else {
        //updateDisplay(lines[line+1]);
      }
      //line=0;
      break;
    case PAGE_SQUARE:
      if ((int)((float)line/(float)encoder_sensitivity) == line_count[page]-1) {
        page = 0;
        line=0;
      } else {
        //updateDisplay(lines[line+1]);
      }
      //line=0;
      break;
    case PAGE_COM:
      if ((int)((float)line/(float)encoder_sensitivity) == line_count[page]-1) {
        page = 0;
        line=0;
      } else {
        //updateDisplay(lines[line+1]);
      }
      //line=0;
      break;
  }
}

int scale = 1;
void updateDisplay(const char* data[],int len) {
      oline = line;
      opage = page;
      display.clearDisplay();
      for (int i = 0; i < len; ++i) {
        uint16_t fg = WHITE;
        uint16_t bg = BLACK;
        if ((int)((float)line/(float)encoder_sensitivity) == i) {
          fg = BLACK;
          bg = WHITE;
        }
        for (int j=0; j<strlen(data[i]); ++j) {
          display.drawChar(scale*5*j,scale*7*i+3,data[i][j],fg,bg,scale);
        }
      }
      display.display();
}

void initOLED() {
  display.begin(SSD1306_SWITCHCAPVCC, 0x3C,false);  // initialize with the I2C addr 0x3C (for the 128x64), no reset pin
  display.clearDisplay(); //Hide Adafruit logo
  
  // Show image buffer on the display hardware.
  display.drawBitmap(0, 0, sine, 128, 64, WHITE);
  display.display();
  delay(1000);

  // Clear the buffer.
  display.clearDisplay();
}

void initIO() {
  
  //Setup all outputs!
  //D = Digital
  //A = Analog
  //B = Buffered
  //P = PWM
  //D  D  A  P  P  B  B   A
  //0, 1, 3, 5, 6, 9, 10, 11
  
  pinMode(3, OUTPUT);
  pinMode(11, OUTPUT);
  
  pinMode(encoder0PinA, INPUT); 
  digitalWrite(encoder0PinA, HIGH);
  
  pinMode(encoder0PinB, INPUT); 
  digitalWrite(encoder0PinB, HIGH);
  
  pinMode(button, INPUT); 
  digitalWrite(button, HIGH);
}
int button_last = -1;
int encoder_last = -1;

void initInterrupts() {
  cli(); //Clear Interrupts
  PCICR = 0x02; //Enable PCINT1 Interrupt
  PCMSK1 = 0b00000111; //??
  
  //set timer2 interrupt at 40kHz
  TCCR2A = 0;// set entire TCCR2A register to 0
  TCCR2B = 0;// same for TCCR2B
  TCNT2  = 0;//initialize counter value to 0
  // set compare match register for 40khz increments
  OCR2A = 49;// = (16*10^6) / (8*40000)-1
  // turn on CTC mode
  TCCR2A |= (1 << WGM21);
  // Set CS21 bit for 8 prescaler
  TCCR2B |= (1 << CS21);  
  // enable timer compare interrupt
  TIMSK2 |= (1 << OCIE2A);
  
  sei(); //Set Interrupts
  
  //TCCR2A = _BV(COM2A1) | _BV(COM2B1) | _BV(WGM20);
  //TCCR2B = _BV(CS22);
  //OCR2A = 180;
  //OCR2B = 50;
}


//sends 63Hz sine wave to arduino PORTD DAC
volatile unsigned int t = 0;

ISR(TIMER2_COMPA_vect) {
  //increment t
  t+=1;
  /*
  if (t==512){//40kHz/512 = 78.125Hz
    t=0;
  }
  */
  
  if (t==256){//40kHz/512 = 78.125Hz
    t=0;
  }
  
  
}


/*
//PortB pin change interrupt
ISR(PCINT0_vect) {
}

//PortD pin change interrupt
ISR(PCINT2_vect) {
}
*/

//PortC pin change interrupt
ISR(PCINT1_vect) {
  int enctemp = digitalRead(encoder0PinA);
  if (enctemp  != encoder_last) { //Read on falling or rising edge
    encoder_last = enctemp;
    handleEncoder();   
  }
  int buttemp = digitalRead(button);
  if (buttemp != button_last) {
    button_last = buttemp;
    if (buttemp) //Only care about one edge of the button press
      handleButton();
  }
}

void setup() {
  //Serial.begin(9600);
  initOLED();
  initIO();
  initInterrupts();
}

int i = 0;
void loop(){
  if (opage != page || (int)((float)oline/(float)encoder_sensitivity) != (int)((float)line/(float)encoder_sensitivity)) {
    updateDisplay(lines[page], line_count[page]);
  }
  
//  analogWrite(11,pgm_read_byte_near(tri + t));
  //analogWrite(11,pgm_read_byte_near(sine256 + t));
  OCR2B = pgm_read_byte_near(sine256 + t);
  OCR2A = pgm_read_byte_near(sine256 + t);
}

/*
make menu handling function
make timer function that uses variables that are modified in the menu function for indexing into arrays of waveforms
waveforms[WAVE][SAMPLE]
byte waveforms[][] = {
{0x00,0x01},//sine
{0x00,0x01}//triangle
}
*/

